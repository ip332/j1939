VERSION "redistributable subscriptions prototype"

BO_ 2566848779 EngineA: 8 ECU
 SG_ Speed : 0|16@1+ (0.125,0) [0|16383.75] "rpm" ECU
 SG_ Temperature : 16|8@1- (0.5,-40) [-104|23.5] "deg C" ECU
 SG_ Mode M : 24|8@1+ (1,0) [0|255] "" ECU
 SG_ Load m1 : 32|8@1+ (0.4,0) [0|102] "%" ECU
 SG_ Status : 40|8@1+ (1,0) [0|255] "" ECU

BO_ 2566848780 EngineAlias: 8 ECU
 SG_ Speed : 0|16@1+ (0.125,0) [0|16383.75] "rpm" ECU
 SG_ Temperature : 16|8@1- (0.5,-40) [-104|23.5] "deg C" ECU
 SG_ Mode M : 24|8@1+ (1,0) [0|255] "" ECU
 SG_ Load m1 : 32|8@1+ (0.4,0) [0|102] "%" ECU
 SG_ Status : 40|8@1+ (1,0) [0|255] "" ECU

BO_ 2566848830 EngineB: 8 ECU
 SG_ Speed : 0|16@1+ (0.25,0) [0|16383.75] "rpm" ECU
 SG_ Temperature : 16|8@1- (0.5,-40) [-104|23.5] "deg C" ECU
 SG_ Mode M : 24|8@1+ (1,0) [0|255] "" ECU
 SG_ Load m1 : 32|8@1+ (0.4,0) [0|102] "%" ECU
 SG_ Status : 40|8@1+ (1,0) [0|255] "" ECU

BO_ 2566849035 Pressure: 8 ECU
 SG_ Pressure : 7|16@0+ (2,-5) [0|131065] "kPa" ECU

BO_ 100 Counter: 1 ECU
 SG_ Count : 0|8@1+ (1,0) [0|255] "" ECU

BO_ 2566849291 WideUnsigned: 8 ECU
 SG_ Wide : 0|64@1+ (1,0) [0|18446744073709551615] "count" ECU

BO_ 2566849803 WideSigned: 8 ECU
 SG_ Wide : 0|64@1- (1,0) [-9223372036854775808|9223372036854775807] "count" ECU

BA_ "J1939Default" BO_ 2566848779 1;
VAL_ 2566848779 Status 0 "Off" 255 "Reserved label without quality policy" ;
VAL_ 2566848780 Status 0 "Off" 255 "Reserved label without quality policy" ;
VAL_ 2566848830 Status 0 "Off" 255 "Reserved label without quality policy" ;

BO_ 2565808651 Destination: 8 ECU
 SG_ Value : 0|8@1+ (1,0) [0|255] "" ECU

BO_ 2566850059 Overflow: 8 ECU
 SG_ Value : 0|8@1+ (1e308,0) [0|1e308] "test unit" ECU
BA_ "SPN" SG_ 2566848779 Speed 100;
BA_ "SPN" SG_ 2566848779 Load 100;
BA_ "SPN" SG_ 2566848830 Speed 100;
BA_ "SPN" SG_ 2566849035 Pressure 0;
