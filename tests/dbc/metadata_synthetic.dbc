VERSION "metadata fixture 1"

BO_ 100 ScalarMux: 8 ECU
 SG_ Count : 0|8@1+ (010,+000) [0|255] "rev per min" Receiver
 SG_ Switch M : 8|8@1+ (1,0) [0|255] "" Receiver
 SG_ A m0 : 16|8@1- (0.25,-2) [-34|29.75] "deg C" Receiver
 SG_ B m1 : 16|8@1- (0.5,-1) [-65|62.5] "" Receiver
 SG_ Status : 24|8@1+ (1,0) [0|255] "" Receiver
 SG_ Motorola : 39|12@0- (2.5e-1,+10) [-502|521.75] "deg" Receiver

BO_ 2566849547 SourceA: 8 ECU
 SG_ Temperature : 0|16@1- (0.125,-010) [-1000|1000] "deg C" Receiver

BO_ 2566849598 SourceB: 8 ECU
 SG_ TemperatureAlias : 0|16@1- (0.125,-010) [-1000|1000] "deg C" Receiver

VAL_ 100 Status 0 "Off" 255 "Synthetic marker" ;
BA_ "SPN" SG_ 100 Count 0;
BA_ "SPN" BO_ 2566849547 0;
BA_ "J1939Default" BO_ 2566849598 0;
